#include <avr/io.h>
#include <avr/pgmspace.h> 

#include "trajektorieVorgabe.h"

/* Solltrajektorie */
#define SKALIERUNG 2.0f
#define BESCHLDAUER 10 // Samples

const PROGMEM int8_t dy1_dt[] =  {0,30,30,30,30,30,30,30,30,30,30,30,30,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0,0};
const PROGMEM int8_t dy2_dt[] =  {0,0,0,0,0,0,0,0,0,0,0,0,0,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30,30};
const PROGMEM int8_t dy1_ddt[] =  {0,0,0,0,0,0,0,0,0,0,0,0,0,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23,23};
const PROGMEM int8_t dy2_ddt[] =  {0,0,0,0,0,0,0,0,0,0,0,0,0,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0,0};

/* Globale Variablen */
uint16_t beschleunigungsphase;
uint16_t traj_laenge;
uint16_t i_trj;

/* Initialisierungsfunktion für die Solltrajektorienfunktion */
void trajektorie_init()
{
	// Länge der Trajektorie ermitteln
	traj_laenge = sizeof(dy1_dt) / sizeof(dy1_dt[0]);
	
	// Initialisierung d.h. zuerst Beschleunigungsphase starten
	beschleunigungsphase=1;
	// Trajektorenzähler = 0
	i_trj=0;
}


/* Funktion für den nächsten Wert der Solltrajektorie */
void trajektorie_next(float *y1p, float *y2p, float *y1pp, float *y2pp)
{
	uint16_t j_traj = 0;
	
 	/* Am Anfang Asuro auf Sollgeschwindigkeit schleppen */
	if(beschleunigungsphase)
	{
		// Auf Endgeschwindigkeit beschleunigen
		*y1p  = 30.0/SKALIERUNG * ((float)i_trj/(float)BESCHLDAUER);
		*y2p  = 0.0;
		*y1pp = 30.0/SKALIERUNG / ((float)BESCHLDAUER*0.01);
		*y2pp = 0.0;
		
		i_trj++;
		
		// Beschleunigungsphase zu Ende?
		if(i_trj >= BESCHLDAUER)
		{	beschleunigungsphase=0;
			i_trj=1;
		}
	}
	else
 	{
	
/*		// Gerade
		*y1p = 20.0;
		*y1pp = 0.0;
		*y2p = 0.0;
		*y2pp = 0.0;
		return;
*/
		if (i_trj<traj_laenge)
		{
			// 1. Hälfte der Acht
			*y1p = (float)((int8_t)pgm_read_byte(&dy1_dt[i_trj]))/SKALIERUNG;
			*y2p = (float)((int8_t)pgm_read_byte(&dy2_dt[i_trj]))/SKALIERUNG;
			*y1pp= (float)((int8_t)pgm_read_byte(&dy1_ddt[i_trj]))/SKALIERUNG;
			*y2pp= (float)((int8_t)pgm_read_byte(&dy2_ddt[i_trj]))/SKALIERUNG;
		}
		else if (i_trj< (traj_laenge*2))
		{
			if (i_trj == traj_laenge)
				i_trj ++;
				
			j_traj = i_trj - traj_laenge;

			// 2. Hälfte der Acht (gespiegelte 1. Hälfte)
			*y2p = (float)((int8_t)pgm_read_byte(&dy1_dt[j_traj]))/SKALIERUNG;
			*y1p = (float)((int8_t)pgm_read_byte(&dy2_dt[j_traj]))/SKALIERUNG;
			*y2pp= (float)((int8_t)pgm_read_byte(&dy1_ddt[j_traj]))/SKALIERUNG;
			*y1pp= (float)((int8_t)pgm_read_byte(&dy2_ddt[j_traj]))/SKALIERUNG;
		}
		
		if (i_trj == traj_laenge*2 -1)
		{
			// Trajektorie zu Ende, Zähler auf Anfang setzen
			i_trj=1;
			return;	
		}	
		
		// Nächster Wert der Trajektorie
		i_trj++;
	}
}


